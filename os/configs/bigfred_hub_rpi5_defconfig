## os/configs/bigfred_hub_rpi5_defconfig
```kconfig
# BigFred hub OS — Raspberry Pi 5 (based on upstream raspberrypi5_defconfig)
# Documentation: modelarstwo/rb/docs/loconet-adapter/08-hub-os-image.md
# BigFred application binaries are NOT included (install separately).

BR2_aarch64=y
BR2_cortex_a76=y
BR2_PACKAGE_HOST_LINUX_HEADERS_CUSTOM_6_6=y

# musl toolchain (hub spec §8.5)
BR2_TOOLCHAIN_BUILDROOT_MUSL=y

BR2_GLOBAL_PATCH_DIR="board/raspberrypi/patches"
BR2_DOWNLOAD_FORCE_CHECK_HASHES=y

# Static IP via S15-network overlay (not DHCP)
# BR2_SYSTEM_DHCP is not set

BR2_INIT_BUSYBOX=y
BR2_ROOTFS_DEVICE_CREATION_DYNAMIC_EUDEV=y
BR2_PACKAGE_EUDEV=y

# Console via overlays/etc/inittab (ttyAMA10 + tty1)
# BR2_TARGET_GENERIC_GETTY is not set

BR2_TARGET_GENERIC_HOSTNAME="bigfred-hub"
BR2_TARGET_GENERIC_ISSUE="BigFred hub\n"
BR2_TARGET_GENERIC_ROOT_PASSWD="root"
BR2_TARGET_ENABLE_ROOT_LOGIN=y

BR2_PACKAGE_LINUX_PAM=y

BR2_ROOTFS_OVERLAY="$(BR2_EXTERNAL_BIGFRED_HUB_PATH)/overlays"
BR2_ROOTFS_POST_BUILD_SCRIPT="$(BR2_EXTERNAL_BIGFRED_HUB_PATH)/board/bigfred_hub/post-build.sh"
BR2_ROOTFS_POST_IMAGE_SCRIPT="$(BR2_EXTERNAL_BIGFRED_HUB_PATH)/board/bigfred_hub/post-image.sh"

# Linux kernel (Raspberry Pi 6.6 + hub fragments)
BR2_LINUX_KERNEL=y
BR2_LINUX_KERNEL_CUSTOM_TARBALL=y
BR2_LINUX_KERNEL_CUSTOM_TARBALL_LOCATION="$(call github,raspberrypi,linux,576cc10e1ed50a9eacffc7a05c796051d7343ea4)/linux-576cc10e1ed50a9eacffc7a05c796051d7343ea4.tar.gz"
BR2_LINUX_KERNEL_DEFCONFIG="bcm2712"
BR2_LINUX_KERNEL_CONFIG_FRAGMENT_FILES="$(BR2_EXTERNAL_BIGFRED_HUB_PATH)/configs/linux-4k-page-size.fragment $(BR2_EXTERNAL_BIGFRED_HUB_PATH)/configs/linux-hub.fragment"
BR2_LINUX_KERNEL_DTS_SUPPORT=y
BR2_LINUX_KERNEL_INTREE_DTS_NAME="broadcom/bcm2712-rpi-5-b broadcom/bcm2712d0-rpi-5-b"
BR2_LINUX_KERNEL_NEEDS_HOST_OPENSSL=y

# Firmware / boot
BR2_PACKAGE_RPI_FIRMWARE=y
BR2_PACKAGE_RPI_FIRMWARE_CONFIG_FILE="$(BR2_EXTERNAL_BIGFRED_HUB_PATH)/board/bigfred_hub/config.txt"
BR2_PACKAGE_RPI_FIRMWARE_CMDLINE_FILE="$(BR2_EXTERNAL_BIGFRED_HUB_PATH)/board/bigfred_hub/cmdline.txt"
# BR2_PACKAGE_RPI_FIRMWARE_INSTALL_DTB_OVERLAYS is not set

# Core userspace
BR2_PACKAGE_BUSYBOX=y
BR2_PACKAGE_BUSYBOX_CONFIG_FRAGMENT_FILES="$(BR2_EXTERNAL_BIGFRED_HUB_PATH)/configs/busybox-hub.fragment"
BR2_PACKAGE_BUSYBOX_SHOW_OTHERS=y

BR2_PACKAGE_DROPBEAR=y
BR2_PACKAGE_DROPBEAR_CLIENT=y

BR2_PACKAGE_SQLITE=y
BR2_PACKAGE_REDIS=y
BR2_PACKAGE_HTOP=y
BR2_PACKAGE_IPROUTE2=y
BR2_PACKAGE_ETHTOOL=y
BR2_PACKAGE_LIBCURL=y
BR2_PACKAGE_LIBCURL_CURL=y
BR2_PACKAGE_NMAP_NCAT=y
BR2_PACKAGE_DHCP=y
BR2_PACKAGE_DHCP_DHCLIENT=y
BR2_PACKAGE_WATCHDOG=y

# fanctl: built from apps/fanctl → apps/.bin/ (see post-build.sh)
BR2_PACKAGE_ALLOY=y
BR2_PACKAGE_GRAFANA=y
BR2_PACKAGE_VICTORIAMETRICS=y

BR2_PACKAGE_XZ=y
BR2_PACKAGE_KMOD=y
BR2_PACKAGE_KMOD_TOOLS=y

# Root filesystem image (post-image builds NVMe layout)
BR2_TARGET_ROOTFS_EXT2=y
BR2_TARGET_ROOTFS_EXT2_4=y
BR2_TARGET_ROOTFS_EXT2_SIZE="256M"

BR2_PACKAGE_HOST_DOSFSTOOLS=y
BR2_PACKAGE_HOST_GENIMAGE=y
BR2_PACKAGE_HOST_KMOD_XZ=y
BR2_PACKAGE_HOST_MTOOLS=y
BR2_PACKAGE_HOST_PARTED=y
BR2_PACKAGE_HOST_E2FSPROGS=y
```
