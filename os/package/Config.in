## os/package/Config.in
```kconfig
config BR2_PACKAGE_LINUX_PREBUILT
	bool "Prebuilt Raspberry Pi 5 kernel (hub-kernel)"
	default y
	help
	  Install Image, DTBs, overlays, and modules from a
	  dcc-bigfred/hub-kernel GitHub Release tarball, hash-pinned
	  like Grafana. Kernel CONFIG_* lives in hub-kernel, not here.

	  https://github.com/dcc-bigfred/hub-kernel

config BR2_PACKAGE_ALLOY
	bool "Grafana Alloy (static binary from source)"
	default n
	help
	  Build Grafana Alloy from source as a pure-Go static binary for the
	  musl rootfs. Official release zips are glibc-dynamic and will not
	  run on this image. Runtime state: /data/alloy.

	  Host requirement: go on PATH (docker/install-go.sh, Go ≥ 1.26).

config BR2_PACKAGE_BIGFRED
	bool "BigFred (loco-server)"
	default y
	help
	  Pull hub linux/arm64 binaries from GitHub (Actions tip or Releases)
	  and install /opt/bigfred/bin/{bigfred,bigfred-remote-icmp} plus
	  /usr/bin wrappers that prefer /data/opt/bigfred over /opt.

	  https://github.com/dcc-bigfred/bigfred

if BR2_PACKAGE_BIGFRED

config BR2_PACKAGE_BIGFRED_REF
	string "GitHub ref (master | latest-release | v* | sha-*)"
	default "master"
	help
	  Ref for dcc-bigfred/bigfred binaries.
	  Default: repo-root VERSIONS (BIGFRED_REF).
	  Override: make image BIGFRED_REF=latest-release
	  Tip refs need GITHUB_TOKEN; Releases usually do not.

endif

config BR2_PACKAGE_MICROINIT
	bool "microinit (PID 1 from GitHub)"
	default y
	help
	  Pull microinit linux/arm64 from GitHub (Actions tip or Releases)
	  and install /sbin/init, /usr/sbin/microinit, and /usr/sbin/shutdown.
	  Use with BR2_INIT_NONE so BusyBox does not own /sbin/init.

	  Hub early-boot: overlays/etc/microinit/early-boot.sh
	  https://github.com/dcc-bigfred/microinit

if BR2_PACKAGE_MICROINIT

config BR2_PACKAGE_MICROINIT_REF
	string "GitHub ref (main | sha-<7> | v*)"
	default "main"
	help
	  Ref for dcc-bigfred/microinit binaries.
	  Override: make image MICROINIT_REF=main
	  Tip refs need GITHUB_TOKEN.

endif

config BR2_PACKAGE_MICRONET
	bool "micronet (network daemon from GitHub)"
	default y
	select BR2_PACKAGE_DNSMASQ
	select BR2_PACKAGE_DHCP
	select BR2_PACKAGE_DHCP_CLIENT
	select BR2_PACKAGE_IPROUTE2
	help
	  Pull micronet from GitHub (Actions tip or Releases)
	  into /usr/sbin/micronet. Runtime: /usr/sbin/dnsmasq,
	  /sbin/dhclient, /sbin/ip.

	  https://github.com/dcc-bigfred/micronet

if BR2_PACKAGE_MICRONET

config BR2_PACKAGE_MICRONET_REF
	string "GitHub ref (main | sha-<7> | v* | branch)"
	default "main"
	help
	  Ref for dcc-bigfred/micronet binaries.
	  Override: make image MICRONET_REF=main
	  Until the daemon lands on main, pin to that branch
	  (artifact micronet-linux-arm64). Tip refs need GITHUB_TOKEN.

endif

config BR2_PACKAGE_MICRODNS
	bool "microdns (mDNS advertiser from GitHub)"
	default y
	help
	  Pull microdns from GitHub (Actions tip or Releases) and
	  install /usr/sbin/microdns. Advertises bigfred.local and optional
	  dcc-bus handset discovery.

	  https://github.com/dcc-bigfred/microdns

if BR2_PACKAGE_MICRODNS

config BR2_PACKAGE_MICRODNS_REF
	string "GitHub ref (main | sha-<7> | v*)"
	default "main"
	help
	  Ref for dcc-bigfred/microdns binaries.
	  Override: make image MICRODNS_REF=main

endif

config BR2_PACKAGE_WIRELESS_PROGRAMMER
	bool "wireless-programmer (device discovery + programming from GitHub)"
	default y
	help
	  Pull wireless-programmer from GitHub (Actions tip or Releases)
	  and install /usr/sbin/wireless-programmer. Discovers and programs
	  physical throttle hardware (e.g. NewHeiko WiFred) over WiFi config
	  APs, driven by bigfred / bigfred-wizard via a Unix socket. Needs
	  cfg80211 + brcmfmac SDIO + rfkill (hub-kernel linux-hub.fragment)
	  and Raspberry Pi CYW43455 firmware
	  (BR2_PACKAGE_BRCMFMAC_SDIO_FIRMWARE_RPI_WIFI).

	  https://github.com/dcc-bigfred/wireless-programmer

if BR2_PACKAGE_WIRELESS_PROGRAMMER

config BR2_PACKAGE_WIRELESS_PROGRAMMER_REF
	string "GitHub ref (main | sha-<7> | v*)"
	default "main"
	help
	  Ref for dcc-bigfred/wireless-programmer binaries.
	  Override: make image WIRELESS_PROGRAMMER_REF=main

endif

config BR2_PACKAGE_BIGFRED_WIZARD
	bool "bigfred-wizard (party kiosk from GitHub)"
	default y
	help
	  Pull bigfred-wizard from GitHub (Actions tip or Releases) and
	  install /usr/sbin/bigfred-wizard. Fullscreen kiosk for accounts,
	  handset pairing, and CV programming on the hub tablet (:8091).
	  Config under /data/etc/bigfred/wizard/; proxies BigFred on loopback.

	  https://github.com/dcc-bigfred/bigfred-wizard

if BR2_PACKAGE_BIGFRED_WIZARD

config BR2_PACKAGE_BIGFRED_WIZARD_REF
	string "GitHub ref (main | sha-<7> | v*)"
	default "main"
	help
	  Ref for dcc-bigfred/bigfred-wizard binaries.
	  Override: make image BIGFRED_WIZARD_REF=main
	  Tip refs need GITHUB_TOKEN.

endif

config BR2_PACKAGE_MICROWAF
	bool "microwaf (host WAF from GitHub)"
	default y
	help
	  Pull microwaf from GitHub (Actions tip or Releases) and install
	  /usr/sbin/microwaf. Host-side WAF for HTTP/WebSocket/Z21/WiThrottle
	  and generic UDP/TCP. The microinit service is installed but
	  disabled at boot (enabled: false). Start until next reboot with
	  `microinit start microwaf`. Persistent enable: set enabled true
	  in overlays/etc/microinit.d/services/os/microwaf.json and rebuild.

	  https://github.com/dcc-bigfred/microwaf

if BR2_PACKAGE_MICROWAF

config BR2_PACKAGE_MICROWAF_REF
	string "GitHub ref (main | sha-<7> | v*)"
	default "main"
	help
	  Ref for dcc-bigfred/microwaf binaries.
	  Override: make image MICROWAF_REF=main
	  Tip refs need GITHUB_TOKEN.

endif

config BR2_PACKAGE_GRAFANA
	bool "Grafana OSS (prebuilt binary)"
	default y
	help
	  Install Grafana from the official prebuilt tarball matching the
	  target CPU (arm64 / armv7). Runtime data: /data/var/lib/grafana.
	  Provisions VictoriaMetrics as default datasource and loads dashboard
	  JSON from /data/etc/grafana/dashboards (fetched at build time from
	  bigfred + microinit GitHub refs).

config BR2_PACKAGE_VICTORIAMETRICS
	bool "VictoriaMetrics single-node (prebuilt binary)"
	default y
	help
	  Install VictoriaMetrics from the official GitHub release binary
	  matching the target CPU (arm64 / arm). Runtime data:
	  /data/opt/victoriametrics. Uses a longer in-memory flush interval
	  to reduce disk writes.
```
